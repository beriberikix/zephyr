## drivers/hwinfo/Kconfig.native
```kconfig
# Copyright (c) 2025 Henrik Brix Andersen <henrik@brixandersen.dk>
# SPDX-License-Identifier: Apache-2.0

config HWINFO_NATIVE
	bool "HWINFO driver for native_sim"
	default y
	depends on NATIVE_HOST_HAS_GETHOSTID
	select HWINFO_HAS_DRIVER
	help
	  Enable native_sim HWINFO driver.
```
